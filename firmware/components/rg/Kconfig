## firmware/components/rg/Kconfig
```kconfig
menu "Retro Guestbook"

    menu "GPIO assignment (ESP32-C3 Super Mini)"
        config RG_PIN_I2S_BCLK
            int "I2S BCLK (MAX98357A BCLK + mic SCK)"
            range 0 21
            default 0
        config RG_PIN_I2S_WS
            int "I2S WS (MAX98357A LRC + mic WS)"
            range 0 21
            default 1
        config RG_PIN_SD_CS
            int "MicroSD CS (strapping pin, 100k pull-up)"
            range 0 21
            default 2
        config RG_PIN_HOOK
            int "Hook switch (must be RTC GPIO0-5 for deep-sleep wake)"
            range 0 5
            default 3
        config RG_PIN_SD_SCK
            int "MicroSD SCK"
            range 0 21
            default 4
        config RG_PIN_I2S_DIN
            int "I2S data in (mic SD)"
            range 0 21
            default 5
        config RG_PIN_I2S_DOUT
            int "I2S data out (MAX98357A DIN)"
            range 0 21
            default 6
        config RG_PIN_LED
            int "WS2812B data (via 74AHCT1G125)"
            range 0 21
            default 7
        config RG_PIN_I2C_SDA
            int "OLED SDA"
            range 0 21
            default 8
        config RG_PIN_I2C_SCL
            int "OLED SCL"
            range 0 21
            default 9
        config RG_PIN_PWR_EN
            int "Peripheral power switch enable (100k pull-down, high = rail on)"
            range 0 21
            default 10
        config RG_PIN_SD_MISO
            int "MicroSD MISO"
            range 0 21
            default 20
        config RG_PIN_SD_MOSI
            int "MicroSD MOSI"
            range 0 21
            default 21
    endmenu

    config RG_POWER_SETTLE_MS
        int "Switched 5 V rail settle time after power-on (ms)"
        range 5 500
        default 30
        help
            Covers the P-MOSFET soft start, the SD module regulator and the mic LDO.

    config RG_MAX_RECORD_SECONDS
        int "Default maximum recording length (s)"
        range 10 300
        default 180

    config RG_HOOK_LIFTED_LEVEL
        int "Hook GPIO level when the handset is lifted"
        range 0 1
        default 0
        help
            0 for the recommended COM->GND, NC->GPIO wiring (lifted closes NC to GND).

    config RG_HOOK_DEBOUNCE_MS
        int "Hook debounce time (ms)"
        range 5 500
        default 40

    config RG_SD_FREQ_KHZ
        int "MicroSD SPI clock (kHz)"
        range 400 40000
        default 20000

    config RG_MIC_GAIN_DB
        int "Microphone digital gain (dB)"
        range 0 36
        default 12

    config RG_MIC_DC_BLOCK
        bool "Remove DC offset from microphone samples"
        default y

    config RG_PLAYBACK_VOLUME_DB
        int "Playback volume (dB relative to full scale, <= 0)"
        range -40 0
        default -6

    config RG_LED_MAX_BRIGHTNESS
        int "WS2812B maximum channel value (0-255)"
        range 1 255
        default 40

    config RG_OLED_I2C_ADDR
        hex "SSD1306 I2C address"
        default 0x3C

    config RG_OLED_CONTRAST
        hex "SSD1306 contrast (lower reduces burn-in)"
        range 0x01 0xFF
        default 0x30

endmenu
```

## firmware/guestbook/main/Kconfig.projbuild
```kconfig
menu "Guestbook application"

    config GB_WAKE_CONFIRM_MS
        int "Handset must read 'lifted' this long after wake (ms)"
        range 10 1000
        default 60
        help
            Wakes where the handset does not stay lifted are treated as false wakes
            and go straight back to sleep.

    config GB_SLEEP_STABLE_MS
        int "Handset must stay down this long before deep sleep (ms)"
        range 100 5000
        default 500

    config GB_SUCCESS_SCREEN_MS
        int "KAYIT BASARILI screen + solid green LED (ms)"
        range 500 10000
        default 2000

    config GB_ERROR_SCREEN_MS
        int "Minimum error screen time (ms)"
        range 500 20000
        default 3000

    config GB_SAVE_TIMEOUT_MS
        int "Maximum time to finalize a message before rebooting (ms)"
        range 1000 9000
        default 5000
        help
            Must stay below CONFIG_ESP_TASK_WDT_TIMEOUT_S.

    config GB_RING_KB
        int "Recording RAM ring buffer (KB)"
        range 16 128
        default 64
        help
            Absorbs SD write stalls. Size from hardware test 5 (ring_kb).

    config GB_MIN_FREE_KB
        int "Refuse to start a message with less free card space (KB)"
        range 256 65536
        default 1024

    menu "Listening mode (Wi-Fi)"
        config GB_WIFI_SSID
            string "Fallback network name when the card has no /audio/wifi.txt"
            default ""
            help
                Empty (default): listening mode needs /audio/wifi.txt on the card. A value set
                here lives only in your local, git-ignored sdkconfig.

        config GB_WIFI_PASSWORD
            string "Fallback password when the card has no /audio/wifi.txt (8..63 characters)"
            default ""
            help
                Empty (default): listening mode needs /audio/wifi.txt on the card.

        config GB_WIFI_CHANNEL
            int "Access point channel"
            range 1 13
            default 6

        config GB_WIFI_TX_POWER_QDBM
            int "Maximum transmit power (0.25 dBm units)"
            range 8 84
            default 34
            help
                34 = 8.5 dBm. ESP32-C3 Super Mini boards often hold a link better at reduced
                power; raise it only if the phone loses the network a few metres away.

        config GB_WIFI_IDLE_MIN
            int "Leave listening mode after this many idle minutes"
            range 1 60
            default 5
            help
                Idle = handset down, nothing playing and no request from the web page.
    endmenu

    config GB_SOAK_TEST
        bool "Soak test: simulate the hook switch for automated sessions"
        default n
        help
            Phase 5 reliability test. Lift/hang-up are simulated and the device wakes by
            timer. Real MSG files are written. Never enable for an event build.

    config GB_SOAK_SESSIONS
        int "Soak test sessions"
        depends on GB_SOAK_TEST
        range 1 10000
        default 100

    config GB_SOAK_RECORD_S
        int "Soak test: seconds recorded per normal session"
        depends on GB_SOAK_TEST
        range 1 60
        default 4

endmenu
```
